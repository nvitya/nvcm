
MEMORY
{
  FLASH (rx) :    ORIGIN = 0x00000000, LENGTH = 512K

  ITCRAM (rwx) :  ORIGIN = 0x04000000, LENGTH = 32K
  RAM2 (xrw) :    ORIGIN = 0x20000000, LENGTH = 160K
}

REGION_ALIAS("RAM", ITCRAM);
/* REGION_ALIAS("RAM", RAM2); */
REGION_ALIAS("DTCRAM", ITCRAM);
REGION_ALIAS("TEXT", FLASH);

INCLUDE nvcm_default_flash.ld
