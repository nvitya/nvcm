MEMORY
{
  FLASH (rx) :    ORIGIN = 0x08000000, LENGTH = 128K
  RAM (xrw) :     ORIGIN = 0x20000000, LENGTH = 22K
  ITCRAM (xrw) :  ORIGIN = 0x10000000, LENGTH = 10K
}

REGION_ALIAS("TEXT", FLASH);
REGION_ALIAS("DTCRAM", RAM);
REGION_ALIAS("RAM2", RAM);

INCLUDE nvcm_default_flash.ld

