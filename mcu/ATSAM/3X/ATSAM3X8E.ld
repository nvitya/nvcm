MEMORY
{
  FLASH (rx) : ORIGIN = 0x00080000, LENGTH = 512K
  RAM (xrw) :  ORIGIN = 0x20000000, LENGTH = 64K
}

REGION_ALIAS("TEXT", FLASH);
REGION_ALIAS("ITCRAM", RAM);
REGION_ALIAS("DTCRAM", RAM);
REGION_ALIAS("RAM2", RAM);

INCLUDE nvcm_default_flash.ld

