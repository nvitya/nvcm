MEMORY
{
  FLASH (rx) :    ORIGIN = 0x00000000, LENGTH = 16K
  RAM (xrw) :     ORIGIN = 0x10000000, LENGTH = 4K
}

REGION_ALIAS("ITCRAM", RAM);
REGION_ALIAS("DTCRAM", RAM);
REGION_ALIAS("RAM2", RAM);

REGION_ALIAS("TEXT", FLASH);

INCLUDE nvcm_default_flash.ld
